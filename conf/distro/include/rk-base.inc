## conf/distro/include/rk-base.inc
```bitbake
require conf/distro/poky.conf

DISTRO = "rk-base"
DISTRO_NAME = "Rockchip Distro Base"
SDK_VENDOR = "-rksdk"

TARGET_VENDOR = "-rk"

XSERVER ?= "xserver-xorg \
		   xf86-input-libinput \
		   xf86-video-modesetting"

LICENSE_FLAGS_WHITELIST = "commercial license"

DISTRO_FEATURES += " \
		alsa \
		usbgadget \
		usbhost \
		bluez5 \
		systemd \
		x11 \
		wayland \
		"
```

## conf/layer.conf
```bitbake
# We have a conf and classes directory, add to BBPATH
BBPATH .= ":${LAYERDIR}"

# We have recipes-* directories, add to BBFILES
BBFILES += "${LAYERDIR}/recipes-*/*/*.bb ${LAYERDIR}/recipes-*/*/*.bbappend"

BBFILE_COLLECTIONS += "nanopi_neo4"
BBFILE_PATTERN_nanopi_neo4 = "^${LAYERDIR}/"
BBFILE_PRIORITY_nanopi_neo4 = "1"

# This should only be incremented on significant changes that will
# cause compatibility issues with other layers
LAYERVERSION_nanopi_neo4 = "1"

LAYERDEPENDS_nanopi_neo4 = "core"
LICENSE_PATH += "${LAYERDIR}/licenses"

BBFILES += "${@' '.join('${LAYERDIR}/dynamic-layers/%s/recipes*/*/*.bbappend' % layer \
               for layer in BBFILE_COLLECTIONS.split())}"
BBFILES += "${@' '.join('${LAYERDIR}/dynamic-layers/%s/recipes*/*/*.bb' % layer \
               for layer in BBFILE_COLLECTIONS.split())}"
               
LAYERSERIES_COMPAT_nanopi_neo4 = "sumo thud"
```

## conf/local.conf.sample
```bitbake
# Common configuration for all Machine types
AUTHOR = "Dimitris Tassopoulos"
MACHINE ?= "rockchip"
DISTRO ?= "poky"

PACKAGE_CLASSES ?= " package_deb"
USER_CLASSES = "buildstats image-mklibs image-prelink"
RM_OLD_IMAGE = "1"
CONF_VERSION = "1"

INHERIT += " rm_work"

DISTRO_FEATURES_append = " systemd"
VIRTUAL-RUNTIME_init_manager = "systemd"
DISTRO_FEATURES_BACKFILL_CONSIDERED = "sysvinit"

BB_GENERATE_MIRROR_TARBALLS = "1"

DL_DIR ?= "${BSPDIR}/downloads/"
TMPDIR = "${TOPDIR}/tmp"

SDKMACHINE = "x86_64"

WKS_FILE ?= "${IMGDEPLOYDIR}/${IMAGE_BASENAME}.wks"

# Extra host tools that are used in this BSP
HOSTTOOLS += "lsdiff"

PREFERRED_VERSION_u-boot ?= "v2020.01%"
PREFERRED_VERSION_u-boot-fw-utils ?= "v2020.01%"

PREFERRED_PROVIDER_virtual/kernel ?= "linux-stable"
PREFERRED_VERSION_linux-stable ?= "5.4%"

# In case you need the rt-kernel uncomment the two lines below
#PREFERRED_PROVIDER_virtual/kernel = "linux-stable-rt"
#PREFERRED_VERSION_linux-stable-rt = "5.4%"

#SSID = "YOUR_SSID"
#PSK = YOUR_SSID_PASSWORD"

# In armbian those flags are enabled by default.
# These are used in meta-allwinner-hx/recipes-kernel/linux/linux-stable.inc
# in order to add extra functionality into the kernel. To disable them
# just set it to `no`
EXTRAWIFI = "yes"
WIREGUARD = "yes"
AUFS = "yes"

# For debugging u-boot and kernel
#RM_WORK_EXCLUDE += " linux-stable u-boot"

# Add your custom config under this line
```

## conf/machine/include/rk3399.inc
```bitbake
# Copyright (C) 2017 Jacob Chen
# Released under the MIT license (see COPYING.MIT for the terms)

SOC_FAMILY = "rk3399"

require conf/machine/include/arm/arch-armv8a.inc
require conf/machine/include/soc-family.inc

RK_MALI_LIB := "libmali-midgard-t86x-r14p0${@bb.utils.contains('DISTRO_FEATURES', 'wayland', '-wayland', bb.utils.contains('DISTRO_FEATURES', 'x11', '', '-gbm', d), d)}.so"

SERIAL_CONSOLES = "1500000;ttyS2"
KERNEL_IMAGETYPE = "Image"

SPL_BINARY = "u-boot-dtb.bin"

OVERLAY_PREFIX ?= "rockchip"
DEFAULT_OVERLAYS ?= ""

# Add the wks creation class. This will enable the custom
# wks file creation per image
IMAGE_FSTYPES += "ext4 rkboot wksbuild wic.bz2 wic.bmap"
IMAGE_CLASSES += "nanopi-neo4-boot-partition nanopi-neo4-create-wks"

# Install the kernel modules
MACHINE_EXTRA_RRECOMMENDS += " \
        kernel-modules \
	    ${RK_WIFIBT_FIRMWARES} \
"

MACHINEOVERRIDES .= ":rockchip"


# Custom kernel might not support newest python
PACKAGECONFIG_remove_pn-perf += " scripting"

PREFERRED_PROVIDER_virtual/egl ?= "rockchip-libmali"
PREFERRED_PROVIDER_virtual/libgles1 ?= "rockchip-libmali"
PREFERRED_PROVIDER_virtual/libgles2 ?= "rockchip-libmali"
PREFERRED_PROVIDER_virtual/libgles3 ?= "rockchip-libmali"
PREFERRED_PROVIDER_virtual/libopencl ?= "rockchip-libmali"
PREFERRED_PROVIDER_virtual/libgbm ?= "rockchip-libmali"
PACKAGECONFIG_pn-wayland = "${@ 'no-egl' if 'wayland' in d.getVar('RK_MALI_LIB') else '' }"

# HACK: Use libmali's KHR headers
PACKAGECONFIG_append_pn-mesa-gl += " no-khr-headers"
DEPENDS_append_pn-mesa-gl += " rockchip-libmali"

PREFERRED_PROVIDER_virtual/libgl ?= "mesa-gl"
PREFERRED_PROVIDER_virtual/mesa ?= "mesa-gl"

DEFAULTTUNE_rk3399 = "aarch64"
```

## conf/machine/nanopi-neo4.conf
```bitbake
# Copyright (C) 2017 Fuzhou Rockchip Electronics Co., Ltd
# Released under the MIT license (see COPYING.MIT for the terms)

#@TYPE: Machine
#@NAME: Nanopi-Neo4 (RK3399)
#@DESCRIPTION: Nanopi-Neo4 is bsed on the Six-Core 64-bit RK3399 SoC (https://wiki.friendlyarm.com/wiki/index.php/NanoPi_NEO4)

require conf/machine/include/rk3399.inc

UBOOT_MACHINE ?= "nanopi4_defconfig"

SERIAL_CONSOLES ?= "115200;ttyFIQ0"

# KBUILD_DEFCONFIG ?= "nanopi4_linux_defconfig"
KERNEL_DEVICETREE ?= "rockchip/rk3399-nanopi4-rev04.dtb"

# Enable overclocking?
RK3399_OVERCLOCKING ?= "1"
```
